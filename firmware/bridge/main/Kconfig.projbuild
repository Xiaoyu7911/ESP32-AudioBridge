## firmware/bridge/main/Kconfig.projbuild
```kconfig
menu "ESP Audio Bridge"
    choice EAB_UART_SPEED
        prompt "Fixed UART speed (sender must match)"
        default EAB_UART_3M
        config EAB_UART_3M
            bool "3000000 baud"
        config EAB_UART_2M
            bool "2000000 baud"
    endchoice
    config EAB_UART_BAUD
        int
        default 2000000 if EAB_UART_2M
        default 3000000
endmenu
```

## firmware/bridge/sdkconfig.defaults
```kconfig
CONFIG_IDF_TARGET="esp32s3"
CONFIG_ESPTOOLPY_FLASHMODE_DIO=y
CONFIG_ESPTOOLPY_FLASHFREQ_40M=y
CONFIG_ESPTOOLPY_FLASHSIZE_4MB=y
CONFIG_PARTITION_TABLE_CUSTOM=y
CONFIG_PARTITION_TABLE_CUSTOM_FILENAME="partitions.csv"
CONFIG_ESP_CONSOLE_NONE=y
CONFIG_ESP_CONSOLE_SECONDARY_NONE=y
CONFIG_LOG_DEFAULT_LEVEL_NONE=y
CONFIG_LOG_MAXIMUM_LEVEL=0
CONFIG_BOOTLOADER_LOG_LEVEL_NONE=y
CONFIG_UAC_SPEAKER_CHANNEL_NUM=0
CONFIG_UAC_MIC_CHANNEL_NUM=1
CONFIG_UAC_SAMPLE_RATE=48000
CONFIG_UAC_BIT_RESOLUTION_16=y
CONFIG_UAC_MIC_INTERVAL_MS=10
CONFIG_UAC_TUSB_PRODUCT="ESP Audio Bridge"
CONFIG_FREERTOS_HZ=1000
```
